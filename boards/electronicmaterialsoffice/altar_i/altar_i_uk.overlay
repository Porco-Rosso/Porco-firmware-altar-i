/*
 * Copyright (c) 2025 Electronic Materials Office Ltd.
 *
 * SPDX-License-Identifier: MIT
 */
 
#include "altar_i-layouts.dtsi"

/ {
    model = "Altar I, Rev. 1 (UK)";
    compatible = "electronicmaterials_office,altar_i";

    chosen {
        zmk,physical-layout = &layout_uk;
    };
};
