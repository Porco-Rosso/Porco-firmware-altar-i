## Kconfig
```kconfig
# Copyright (c) 2025 Electronic Materials Office Limited
# SPDX-License-Identifier: MIT

rsource "src/Kconfig"
```

## boards/electronicmaterialsoffice/altar_i/Kconfig.altar_i
```kconfig
# Copyright (c) 2025 Electronic Materials Office Ltd.
# SPDX-License-Identifier: MIT

config BOARD_ALTAR_I
    select SOC_NRF52840_QIAA
    imply RETAINED_MEM
    imply RETENTION
    imply RETENTION_BOOT_MODE

choice ZMK_BOOTMODE_MAGIC_VALUE_BOOTLOADER_TYPE
    default ZMK_BOOTMODE_MAGIC_VALUE_BOOTLOADER_TYPE_ADAFRUIT_NRF52
endchoice
```

## boards/electronicmaterialsoffice/altar_i/Kconfig.defconfig
```kconfig
# Copyright (c) 2025 Electronic Materials Office Limited
# SPDX-License-Identifier: MIT

if BOARD_ALTAR_I

config ZMK_KEYBOARD_NAME
    default "Altar I"

if USB

config USB_NRFX
    default y

config USB_DEVICE_STACK
    default y

endif # USB

config HAS_BT_CTLR
    default BT

endif
```

## boards/electronicmaterialsoffice/altar_i/altar_i_defconfig
```kconfig
# Copyright (c) 2025 Electronic Materials Office Limited
# SPDX-License-Identifier: MIT

CONFIG_USB_DEVICE_MANUFACTURER="Electronic Materials Office Limited"
CONFIG_BT_DIS_MANUF_NAME_STR="Electronic Materials Office Limited"

CONFIG_ARM_MPU=y
CONFIG_PINCTRL=y
CONFIG_GPIO=y
CONFIG_ADC=y

CONFIG_EC11=y
CONFIG_EC11_TRIGGER_GLOBAL_THREAD=y
CONFIG_ZMK_EC11_AUTO_OFF=y
CONFIG_ZMK_EC11_AUTO_OFF_IDLE=y
# CONFIG_ZMK_EC11_AUTO_OFF_SLEEP=y

CONFIG_LED=y
CONFIG_LED_PWM=y
CONFIG_PWM=y
CONFIG_ZMK_HID_INDICATORS=y

CONFIG_USE_DT_CODE_PARTITION=y
CONFIG_BUILD_OUTPUT_UF2=y

CONFIG_MPU_ALLOW_FLASH_WRITE=y
CONFIG_NVS=y
CONFIG_SETTINGS_NVS=y
CONFIG_FLASH=y
CONFIG_FLASH_PAGE_LAYOUT=y
CONFIG_FLASH_MAP=y

CONFIG_ZMK_SLEEP=y
CONFIG_ZMK_IDLE_SLEEP_TIMEOUT=900000
CONFIG_ZMK_BATTERY_REPORT_INTERVAL=180

CONFIG_BT_CTLR_TX_PWR_PLUS_8=y
CONFIG_BT_CTLR_PHY_2M=n
CONFIG_BT_GATT_ENFORCE_SUBSCRIPTION=n

CONFIG_ZMK_USB=y
CONFIG_ZMK_BLE=y
```

## boards/electronicmaterialsoffice/altar_i/board.yml
```yaml
# Copyright (c) 2025 Electronic Materials Office Limited
# SPDX-License-Identifier: MIT

board:
  name: altar_i
  vendor: electronicmaterialsoffice
  revision:
    format: custom
    default: us
    revisions:
      - name: us
      - name: uk
  socs:
    - name: nrf52840
```
